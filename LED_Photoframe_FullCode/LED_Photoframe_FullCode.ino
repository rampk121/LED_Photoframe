//GMM
/************************************************************************************************************************
/////////////////////////////////////////////////////////////////////////////////////////////////////////////////////////
//                       Heartrate controlled LED Photoframe                                                           //
//                       By Ram PK                                                                                     //
/////////////////////////////////////////////////////////////////////////////////////////////////////////////////////////
************************************************************************************************************************/

#include <FastLED.h>
#include <Wire.h>
#include <Adafruit_GFX.h>
#include <Adafruit_SSD1306.h>
#include "MAX30105.h"
#include <heartRate.h>

#define LED_PIN 4                     //Data input pin of WS2812B LED
#define NUM_LEDS 224                  //Total Number of LEDs


MAX30105 particleSensor;             //Heartrate sensor

const byte RATE_SIZE = 4; //Increase this for more averaging. 4 is good.
byte rates[RATE_SIZE]; //Array of heart rates
byte rateSpot = 0;
long lastBeat = 0; //Time at which the last beat occurred
float beatsPerMinute;
int beatAvg;
int counter = 0;
int bpm =0;

#define SCREEN_WIDTH 128 // OLED display width, in pixels
#define SCREEN_HEIGHT 64 // OLED display height, in pixels
#define OLED_RESET -1
Adafruit_SSD1306 display(SCREEN_WIDTH, SCREEN_HEIGHT, &Wire, OLED_RESET);

#define LOGO_HEIGHT   64
#define LOGO_WIDTH    128

int heart1[] = {116,138,150,168,184,198,197,187,163,156,132,122,100,92,67,59,37,38,56,72,86,106};   //Array of LED index of outer heart shape
const int heart1_size = 22;																																					//Size of outer heart shape
int rate1 = 30;																																											//rate of outer heart shape


int heart3[]= {152, 166, 165, 154, 134, 120, 102, 90, 69, 70, 88, 104, 118, 136};                		//Array of LED index of inner heart shape
const int heart3_size = 14;																																					//Size of inner heart shape

int linearC[] = {32, 33, 34, 35, 36, 37, 38, 39, 40, 41, 42, 43, 44, 45, 46, 47};										//Linear pattern row 1
int linearE[] = {64, 65, 66, 67, 68, 69, 70, 71, 72, 73, 74, 75, 76, 77, 78, 79};										//Linear pattern row 2
int linearG[] = {96, 97, 98, 99, 100, 101, 102, 103, 104, 105, 106, 107, 108, 109, 110, 111};				//Linear pattern row 3
int linearI[] = {128, 129, 130, 131, 132, 133, 134, 135, 136, 137, 138, 139, 140, 141, 142, 143};		//Linear pattern row 4
int linearK[] = {160, 161, 162, 163, 164, 165, 166, 167, 168, 169, 170, 171, 172, 173, 174, 175};		//Linear pattern row 5
int linearM[] = {192, 193, 194, 195, 196, 197, 198, 199, 200, 201, 202, 203, 204, 205, 206, 207};		//Linear pattern row 6
const int linear_size = 16;																																					//Size of linear rows
int startC , startE , startG , startI, startK, startM;																																											//Starting indices

CRGB leds[NUM_LEDS];																																							//RGB led matrix

uint8_t colorIndex1[heart1_size];																																	//Creating color indices for heart shape and linear pattern for random color asssignment
uint8_t colorIndex3[heart3_size];
uint8_t colorIndexC[linear_size];
uint8_t colorIndexE[linear_size];
uint8_t colorIndexG[linear_size];
uint8_t colorIndexI[linear_size];
uint8_t colorIndexK[linear_size];
uint8_t colorIndexM[linear_size];


CRGBPalette16 purplePalette = CRGBPalette16(                                                      //Purple palette for outer heart shape and linear patterns
  CRGB::DarkViolet,
  CRGB::DarkViolet,
  CRGB::DarkViolet,
  CRGB::DarkViolet,

  CRGB::Magenta,
  CRGB::Magenta,
  CRGB::Linen,
  CRGB::Linen,

  CRGB::Magenta,
  CRGB::Magenta,
  CRGB::Purple,
  CRGB::Purple,

  CRGB::Purple,
  CRGB::Purple,
  CRGB::Linen,
  CRGB::Linen


);

CRGBPalette16 yellowPalette = CRGBPalette16(                                              //yellow palette for inner heart shape
  CRGB::Red,
  CRGB::Red,
  CRGB::Yellow,
  CRGB::Yellow,

  CRGB::Orange,
  CRGB::Orange,
  CRGB::Orange,
  CRGB::Orange,

  CRGB::Red,
  CRGB::Red,
  CRGB::Red,
  CRGB::Red,

  CRGB::Yellow,
  CRGB::Yellow,
  CRGB::Orange,
  CRGB::Orange


);

CRGBPalette16 myPal1 = purplePalette;
CRGBPalette16 myPal2 = yellowPalette;

static const unsigned char PROGMEM solid_heart[] =                                                //Solid heart shape bitmap for OLED display
{
	0x00, 0x00, 0x00, 0x00, 0x00, 0x00, 0x00, 0x00, 0x00, 0x00, 0x00, 0x00, 0x00, 0x00, 0x00, 0x00, 
	0x00, 0x00, 0x00, 0x00, 0x00, 0x00, 0x00, 0x00, 0x00, 0x00, 0x00, 0x00, 0x00, 0x00, 0x00, 0x00, 
	0x00, 0x00, 0x00, 0x00, 0x00, 0x00, 0x00, 0x00, 0x00, 0x00, 0x00, 0x00, 0x00, 0x00, 0x00, 0x00, 
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	0x00, 0x00, 0x00, 0x00, 0x00, 0x00, 0x00, 0x00, 0x00, 0x00, 0x00, 0x00, 0x00, 0x00, 0x00, 0x00
};

static const unsigned char PROGMEM listening_heart[] = 																						//Listening heart shape bitmap for OLED display
{
	0x00, 0x00, 0x00, 0x00, 0x00, 0x00, 0x00, 0x00, 0x00, 0x00, 0x00, 0x00, 0x00, 0x00, 0x00, 0x00, 
	0x00, 0x00, 0x00, 0x00, 0x00, 0x00, 0x00, 0x00, 0x00, 0x00, 0x00, 0x00, 0x00, 0x00, 0x00, 0x00, 
	0x00, 0x00, 0x00, 0x00, 0x00, 0x00, 0x00, 0x00, 0x00, 0x00, 0x00, 0x00, 0x00, 0x00, 0x00, 0x00, 
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	0x00, 0x00, 0x00, 0x00, 0x00, 0x00, 0x00, 0x00, 0x00, 0x00, 0x00, 0x00, 0x00, 0x00, 0x00, 0x00
};

static const unsigned char PROGMEM pulse_heart[] = 																								//Pulsing heart shape bitmap for OLED display
{
	0x00, 0x00, 0x00, 0x00, 0x00, 0x00, 0x00, 0x00, 0x00, 0x00, 0x00, 0x00, 0x00, 0x00, 0x00, 0x00, 
	0x00, 0x00, 0x00, 0x00, 0x00, 0x00, 0x00, 0x00, 0x00, 0x00, 0x00, 0x00, 0x00, 0x00, 0x00, 0x00, 
	0x00, 0x00, 0x00, 0x00, 0x00, 0x00, 0x00, 0x00, 0x00, 0x00, 0x00, 0x00, 0x00, 0x00, 0x00, 0x00, 
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	0x00, 0x00, 0x00, 0x00, 0x00, 0x00, 0x00, 0x00, 0x00, 0x00, 0x00, 0x00, 0x00, 0x00, 0x00, 0x00
};

static const unsigned char PROGMEM big_heart[] = 																									//Big heart shape bitmap for OLED display
{
	0x00, 0x00, 0x00, 0x00, 0x00, 0x00, 0x00, 0x00, 0x00, 0x00, 0x00, 0x00, 0x00, 0x00, 0x00, 0x00, 
	0x00, 0x00, 0x00, 0x00, 0x00, 0x00, 0x00, 0x00, 0x00, 0x00, 0x00, 0x00, 0x00, 0x00, 0x00, 0x00, 
	0x00, 0x00, 0x00, 0x00, 0x00, 0x00, 0x00, 0x00, 0x00, 0x00, 0x00, 0x00, 0x00, 0x00, 0x00, 0x00, 
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	0x00, 0x00, 0x00, 0x00, 0x00, 0x00, 0x00, 0x00, 0x00, 0x00, 0x00, 0x00, 0x00, 0x00, 0x00, 0x00
};

bool linear_enable = true;																																			//Variable to enable/disable the linear rain LED pattern or the heart LED pattern
bool heart_enable = false;


void setup() {
  // Initialize Display
  display.begin(SSD1306_SWITCHCAPVCC, 0x3C); 																										//Start the OLED display
  display.display();

  FastLED.addLeds<WS2812, LED_PIN, GRB>(leds, NUM_LEDS);																			//Setup LEDs
  FastLED.setBrightness(255);

   for (int i =0; i < heart1_size; i++){																											//Assign random number to the color index for outer heart shape in the range 0 to 255
    colorIndex1[i] = random8();
  }


  for (int i =0; i < heart3_size; i++){																												//Assign random number to the color index for inner heart shape in the range 0 to 255
    colorIndex3[i] = random8();
  }

  for (int i =0; i < linear_size; i++){																											//Assign random number to the color index for linear patterns in the range 0 to 255
    colorIndexC[i] = random8();
    colorIndexE[i] = random8();
    colorIndexG[i] = random8();
    colorIndexI[i] = random8();
    colorIndexK[i] = random8();
    colorIndexM[i] = random8();
  }

  startC = random(0,linear_size);																												//Assign random numbers to start the linear pattern in each row
  startE = random(0,linear_size);
  startG = random(0,linear_size);
  startI= random(0,linear_size);
  startK = random(0,linear_size);
  startM = random(0,linear_size);

  // Initialize MAX30102
  particleSensor.begin(Wire, I2C_SPEED_FAST);
  particleSensor.setup(); //Configure sensor with default settings
  particleSensor.setPulseAmplitudeRed(0x0A); //Turn Red LED to low to indicate sensor is running
  particleSensor.setPulseAmplitudeGreen(0); //Turn off Green LED

  testdrawsolid();                                                                     //Draw the starting OLED message

}

void loop() {

    run_linear_rainPalette();                                                       //Run the linear LED pattern 
    long irValue = particleSensor.getIR();

      
        if (checkForBeat(irValue) == true)                                        //Check if MAX30102 detects a beat
        {
        //We sensed a beat!
        counter++;
         long delta = millis() - lastBeat;
          lastBeat = millis();

          beatsPerMinute = 60 / (delta / 1000.0);                                //Calculate BPM

          if (beatsPerMinute < 255 && beatsPerMinute > 40)
          {
            rates[rateSpot++] = (byte)beatsPerMinute; //Store this reading in the array
            rateSpot %= RATE_SIZE; //Wrap variable

            //Take average of readings
            beatAvg = 0;
            for (byte x = 0 ; x < RATE_SIZE ; x++)
            beatAvg += rates[x];
            beatAvg /= RATE_SIZE;
          }

          if (counter < 6)
          {
            testdrawlistening();                                        //While the average BPM is being calculated draw the listening OLED image
            
          }
          else{

            heart_enable = true;																				//Switch to heart LED pattern if the more than 6 BPM averages have been calculated
            linear_enable = false;
            bpm = beatAvg;
            display.clearDisplay();
            display.drawBitmap(0,0, big_heart, 128, 64, 1);						//Draw the beating heart OLED animation and display the average BPM
            display.display();
            display.clearDisplay();
            display.drawBitmap(0,0, pulse_heart, 128, 64, 1);
            display.setTextSize(3);
            display.setTextColor(WHITE);
            display.setCursor(70, 5);
            display.println("BPM");                                   
            display.setCursor(70, 30);
            display.println(beatAvg);                               //Display the average BPM calculated from the sensor readings
            display.display();
            
          }

        }  


  if (irValue < 50000)                                             //If no finger detected display the solid heart OLED image
   { 
    // Serial.print(" No finger?");
    counter = 0;
    heart_enable = false;																					//Disable the heart LED pattern and switch to linear rain LED pattern
    linear_enable = true;																			
    testdrawsolid();
   }

  // Serial.println();
  run_linear_rainPalette();																				//Function to run the linear rain LED pattern
  run_heart_SinBeatPalette();																			//Function to run the heart LED pattern

}

void run_linear_rainPalette()                    
{
  if (linear_enable==true)
  {
  uint8_t sinBeat = beatsin8(60, 0, 255, 0, 0);                                    //creating a sine wave at 60bpm
  CRGBPalette16 Pal = purplePalette;

  assign_linear(linearC, Pal, colorIndexC, sinBeat, startC);											//passing each linear row to the assign_linear function to assign the color and brightness of each LED
  assign_linear(linearE, Pal, colorIndexE, sinBeat, startE);
  assign_linear(linearG, Pal, colorIndexG, sinBeat, startG);
  assign_linear(linearI, Pal, colorIndexI, sinBeat, startI);
  assign_linear(linearK, Pal, colorIndexK, sinBeat, startK);
  assign_linear(linearM, Pal, colorIndexM, sinBeat, startM);

  EVERY_N_MILLISECONDS(200){																										//update the start index every 200 milliseconds
      startC = update_start(startC);
      startE = update_start(startE);
      startG = update_start(startG);
      startI = update_start(startI);
      startK = update_start(startK);
      startM = update_start(startM);
      fadeToBlackBy(leds, NUM_LEDS, 100);																			//Fade the brightness of the LEDs by 100
  }
    //BLUR
  EVERY_N_MILLISECONDS(1){																										//Apply Blur filter to LEDs every 1 millisecond
    for (int i =0; i<1; i++)
    {
      blur1d(leds, NUM_LEDS, 3);
    }
  }
 
  FastLED.show();																															//Show the LEDs
  }
}

void run_heart_SinBeatPalette()
{
  if (heart_enable == true)
  {
  uint8_t sinBeat1 = beatsin8(bpm, 0, 255, 0, 0);                           //Create a sine wave with the calculated bpm from the heartrate sensor for the large heart shape

  for (int i =0; i< heart1_size; i++)
  {
    leds[heart1[i]]= ColorFromPalette(myPal1, colorIndex1[i], sinBeat1);  //controlling Brightness with sinBeat and assigning each LED with a color from the Palette
  }

  uint8_t sinBeat2 = beatsin8(bpm, 0, 255, 0, 127);                        //Create a sine wave with the calculated bpm from the heartrate sensor and a phase offset for the small heart shape 

  for (int i =0; i< heart3_size; i++)
  {
    leds[heart3[i]]= ColorFromPalette(myPal2, colorIndex3[i], sinBeat2);  //controlling Brightness with sinBeat and assigning each LED with a color from the Palette
  }

  EVERY_N_MILLISECONDS(5){                                                //Change the color index every 5 millisecond to randomize the result
    for (int i =0; i<heart1_size; i++)
    {
      colorIndex1[i]++;
    }
    for (int i =0; i<heart3_size; i++)
    {
      colorIndex3[i]++;
    }

  }
    //BLUR
  EVERY_N_MILLISECONDS(1){																							//Apply Blur filter to LEDs every 1 millisecond
    for (int i =0; i<4; i++)
    {
      blur1d(leds, NUM_LEDS, 3);
    }
  }
  FastLED.show();																											//Show the LEDs
  }
}


void assign_linear(int linear[], CRGBPalette16 Pal, uint8_t colorIndex[], uint8_t sinBeat, int start)
{
  int inc = 2;
  for (int i =start; i< start+inc; i++)
  {
    leds[linear[i]]= ColorFromPalette(Pal, colorIndex[i], sinBeat);  //controlling Brightness with sinBeat and assigning each LED with a color from the Palette
  }

}

int update_start(int start)        //Update start indices of the linear row
{
  int inc = 2;
  if (start < linear_size - inc)
  {
    start++;
  }
  else
  {
    start = 0;
  }
  return start;
}

void testdrawsolid()             //Draw solid heart on OLED screen
{
  display.clearDisplay();
  display.drawBitmap(0,0,solid_heart, 128, 64, 1);
  display.setTextSize(2);
  display.setTextColor(WHITE);
  display.setCursor(20, 0);
  display.println("A heart");
  display.setCursor(30, 55);
  display.setTextSize(1);
  display.println("is all I need!");
  display.display();
}

void testdrawlistening()        //Draw listening heart on OLED screen
{
  display.clearDisplay();
  display.drawBitmap(0,5,listening_heart, 128, 64, 1);
  display.setTextSize(1.5);
  display.setTextColor(WHITE);
  display.setCursor(50, 0);
  display.println("Listening ... ");
  display.display();
}







